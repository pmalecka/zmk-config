## config/boards/shields/splitkb_aurora_sofle/Kconfig.shield
```kconfig
# No whitespace after the comma or in the keyboard name!
config SHIELD_SPLITKB_AURORA_SOFLE_DONGLE
    def_bool $(shields_list_contains,splitkb_aurora_sofle_dongle)

config SHIELD_SPLITKB_AURORA_SOFLE_LEFT
    def_bool $(shields_list_contains,splitkb_aurora_sofle_left)

config SHIELD_SPLITKB_AURORA_SOFLE_RIGHT
    def_bool $(shields_list_contains,splitkb_aurora_sofle_right)
```

## config/west.yml
```yaml
manifest:
  remotes:
    - name: zmkfirmware
      url-base: https://github.com/zmkfirmware
    # Additional modules containing boards/shields/custom code can be listed here as well
    # See https://docs.zephyrproject.org/3.2.0/develop/west/manifest.html#projects
    # - name: nickconway
    #   url-base: https://github.com/nickconway
    # - name: urob
    #   url-base: https://github.com/urob
    # - name: petejohanson
    #   url-base: https://github.com/petejohanson
    - name: infused-kim
      url-base: https://github.com/infused-kim
    - name: t0bybr
      url-base: https://github.com/t0bybr
    - name: infely                             # for nice-view-battery
      url-base: https://github.com/infely
    - name: pmalecka                         # for prospector dongle
      url-base: https://github.com/pmalecka
  projects:
    # official ZMK now has another PR merged
    # that make the trackball driver incompatible
    - name: zmk
      remote: zmkfirmware
      revision: main
      import: app/west.yml
    # - name: zmk
    #   remote: nickconway
    #   revision: dev
    #   import: app/west.yml
    # - name: zmk
    #   remote: urob
    #   revision: main
    #   import: app/west.yml
    # - name: zmk
    #   remote: petejohanson
    #   revision: feat/pointers-move-scroll
    #   import: app/west.yml
    # - name: zmk
    #   remote: infused-kim
    #   revision: pr-testing/mouse_ps2_module_base_urob
    #   import: app/west.yml
    - name: nice-view-battery
      remote: infely
      revision: main
    # - name: prospector-zmk-module
    #   remote: pmalecka
    #   revision: old-zmk
    - name: pim447
      remote: pmalecka
      revision: new-zmk
  self:
    path: config
```
